## firmware/ori/package/suscan/Config.in
```kconfig
config BR2_PACKAGE_SUSCAN
        bool "suscan"
        depends on BR2_TOOLCHAIN_HAS_THREADS
#        depends on BR2_PACKAGE_SNDFILE
        help
          Suscan is a realtime DSP processing library. It provides a set of useful abstractions to perform dynamic digital signal analysis and demodulation. 

          https://github.com/BatchDrake/suscan
comment "sigutils needs a toolchain w/ threads"
        depends on !BR2_TOOLCHAIN_HAS_THREADS
```

## firmware/ori/package/tx-tools/Config.in
```kconfig
config BR2_PACKAGE_TX-TOOLS
        bool "tx-tools"
        depends on BR2_TOOLCHAIN_HAS_THREADS
        depends on BR2_PACKAGE_SOAPYSDR
        help
          tx_sdr tool for transmitting data to SDRs, based on rtl_sdr from librtlsdr, and rx_sdr from rx_tools, using the SoapySDR vendor-neutral SDR support library, intended to support a wide range of TX-capable devices. 

          https://github.com/triq-org/tx_tools
comment "tx_tools needs a toolchain w/ threads"
        depends on !BR2_TOOLCHAIN_HAS_THREADS
```
