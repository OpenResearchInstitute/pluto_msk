## firmware/ori/Config.in
```kconfig
#source pluto_cc.sh
menu "SKRORG"

    source "$BR2_EXTERNAL_PLUTOSDR_PATH/package/libfec/Config.in"
	source "$BR2_EXTERNAL_PLUTOSDR_PATH/package/libtuntap/Config.in"
	source "$BR2_EXTERNAL_PLUTOSDR_PATH/package/lamableu-apps/Config.in"
	source "$BR2_EXTERNAL_PLUTOSDR_PATH/package/rtl-433/Config.in"
	source "$BR2_EXTERNAL_PLUTOSDR_PATH/package/rtlsdr-airband/Config.in"
    source "$BR2_EXTERNAL_PLUTOSDR_PATH/package/luaradio-basic/Config.in"
	source "$BR2_EXTERNAL_PLUTOSDR_PATH/package/multimonng/Config.in"
	source "$BR2_EXTERNAL_PLUTOSDR_PATH/package/libdvbmod/Config.in"
	source "$BR2_EXTERNAL_PLUTOSDR_PATH/package/dvb2iq/Config.in"
    source "$BR2_EXTERNAL_PLUTOSDR_PATH/package/suscan/Config.in"
	source "$BR2_EXTERNAL_PLUTOSDR_PATH/package/sigutils/Config.in"
	source "$BR2_EXTERNAL_PLUTOSDR_PATH/package/soapysdr/Config.in"
	source "$BR2_EXTERNAL_PLUTOSDR_PATH/package/soapyplutosdr/Config.in"
	source "$BR2_EXTERNAL_PLUTOSDR_PATH/package/soapyremote/Config.in"
    source "$BR2_EXTERNAL_PLUTOSDR_PATH/package/rxtools/Config.in"
	source "$BR2_EXTERNAL_PLUTOSDR_PATH/package/tx-tools/Config.in"
	source "$BR2_EXTERNAL_PLUTOSDR_PATH/package/csdr/Config.in"
	source "$BR2_EXTERNAL_PLUTOSDR_PATH/package/dump1090-pluto/Config.in"
	source "$BR2_EXTERNAL_PLUTOSDR_PATH/package/civetwebws/Config.in"
    source "$BR2_EXTERNAL_PLUTOSDR_PATH/package/soapysdr-master/Config.in"
    source "$BR2_EXTERNAL_PLUTOSDR_PATH/package/soapyplutosdr-master/Config.in"
    source "$BR2_EXTERNAL_PLUTOSDR_PATH/package/libgse/Config.in"
    source "$BR2_EXTERNAL_PLUTOSDR_PATH/package/satdump/Config.in"
    source "$BR2_EXTERNAL_PLUTOSDR_PATH/package/nng/Config.in"
	source "$BR2_EXTERNAL_PLUTOSDR_PATH/package/srt/Config.in"
endmenu
```

## firmware/ori/package/charon/Config.in
```kconfig
config BR2_PACKAGE_CHARON
    bool "charon"
    select BR2_PACKAGE_BATCTL
    select BR2_PACKAGE_BRIDGE_UTILS
    select BR2_PACKAGE_FFTWF
    select BR2_PACKAGE_IPERF3
    select BR2_PACKAGE_IPROUTE2
    select BR2_PACKAGE_LIQUID_DSP
    select BR2_PACKAGE_TUNCTL
    select BR2_PACKAGE_UTIL_LINUX
    select BR2_PACKAGE_UTIL_LINUX_SCHEDUTILS
    select BR2_PACKAGE_LIBFEC
    select BR2_PACKAGE_LIBTUNTAP
    help
      Enable your Pluto SDR to become a stand-alone OFDM transceiver with batman-adv mesh network routing capabilities

      https://github.com/tvelliott/charon
```

## firmware/ori/package/csdr/Config.in
```kconfig
config BR2_PACKAGE_CSDR
	bool "csdr"
	depends on BR2_TOOLCHAIN_HAS_THREADS
#	select BR2_PACKAGE_FFTW
#	select BR2_PACKAGE_FFTW_PRECISION_SINGLE
	help
	 csdr is a command line tool to carry out DSP tasks for Software Defined Radio.

	  https://github.com/simonyiszk/csdr

comment "csdr needs a toolchain w/ threads"
        depends on !BR2_TOOLCHAIN_HAS_THREADS
```

## firmware/ori/package/dump1090-pluto/Config.in
```kconfig
config BR2_PACKAGE_DUMP1090_PLUTO
	bool "dump1090-pluto"
	depends on BR2_TOOLCHAIN_HAS_THREADS # librtlsdr
	select BR2_PACKAGE_LIBAD9361_IIO
	help
	  Dump1090 is a simple Mode S decoder for SDR devices (PlutoSDR fork)

	  https://github.com/PlutoSDR/dump1090

comment "dump1090 needs a toolchain w/ threads"
	depends on !BR2_TOOLCHAIN_HAS_THREADS
```

## firmware/ori/package/dvb2iq/Config.in
```kconfig
config BR2_PACKAGE_DVB2IQ
	bool "dvb2iq"
	help
	  A simple library to get I/Q symbols from a MPEG Transport stream

	  https://github.com/F5OEO/libdvbmod
```

## firmware/ori/package/fs/ipk/Config.in
```kconfig
config BR2_TARGET_ROOTFS_IPK_REPO
 bool "Ipk repository with packages"
 default y
 help
  Create a repository compatible with opkg/dpkg tools.

  Each selected packages is splitted in 4 parts:
     - main package with debug symbols stripped off
     - debug symbols
     - development files
     - documentation files
     - locales
 
```

## firmware/ori/package/lamableu-apps/Config.in
```kconfig
config BR2_PACKAGE_LAMABLEU_APPS
	bool "LamaBleu-apps"
	depends on BR2_PACKAGE_LIBIIO
#	select BR2_PACKAGE_LAMABLEU_APPS

	help
	  Some tools for ADALM-Pluto
		http://github.com/LamaBleu
```

## firmware/ori/package/libdvbmod/Config.in
```kconfig
config BR2_PACKAGE_LIBDVBMOD
	bool "libdvbmod"
	help
	  A simple library to get I/Q symbols from a MPEG Transport stream

	  https://github.com/F5OEO/libdvbmod
```

## firmware/ori/package/libfec/Config.in
```kconfig
config BR2_PACKAGE_LIBFEC
    bool "libfec"
    select host-libfec
    help
      This package provides a set of functions that implement several popular forward error correction (FEC) algorithms and several low-level routines useful in modems implemented with digital signal processing (DSP).

      https://github.com/quiet/libfec
```

## firmware/ori/package/libgse/Config.in
```kconfig
config BR2_PACKAGE_LIBGSE
	bool "libgse"
	help
	  LibGSE.

	  https://github.com/CNES/libgse
```

## firmware/ori/package/libosmoplutosdr/Config.in
```kconfig
config BR2_PACKAGE_LIBOSMOPLUTOSDR
        bool "libosmoplutosdr"
        help
          lib for the experimental plutosdr kernel module

          https://github.com/Hoernchen/libosmoplutosdr
```

## firmware/ori/package/libtuntap/Config.in
```kconfig
config BR2_PACKAGE_LIBTUNTAP
    bool "libtuntap"
    help
      The portable Tun/Tap devices configuration utility

      https://github.com/LaKabane/libtuntap
```

## firmware/ori/package/luaradio-basic/Config.in
```kconfig
config BR2_PACKAGE_LUARADIO_BASIC
        bool "luaradio-basic"
       select BR2_PACKAGE_LUAJIT

        help
         A lightweight, embeddable software-defined radio framework built on LuaJIT 


	  http://luaradio.io

 
```

## firmware/ori/package/multimonng/Config.in
```kconfig
config BR2_PACKAGE_MULTIMONNG
	bool "multimonng"
	help
	  HAMRADIO : multimon-ng decodes the following digital transmission modes:
          POCSAG512 POCSAG1200 POCSAG2400 FLEX EAS UFSK1200 CLIPFSK 
          AFSK1200 AFSK2400 AFSK2400_2 AFSK2400_3 HAPN4800 FSK9600 DTMF
          ZVEI1 ZVEI2 ZVEI3 DZVEI PZVEI EEA EIA CCIR MORSE CW X10

	  https://github.com/EliasOenal/multimon-ng
```

## firmware/ori/package/nng/Config.in
```kconfig
config BR2_PACKAGE_NNG
	bool "nng-master"
	help
	  NNG: Lightweight Messaging Library
	  github (release)

	  https://github.com/nanomsg/nng

	  
```

## firmware/ori/package/rtl-433/Config.in
```kconfig
config BR2_PACKAGE_RTL_433
        bool "rtl-433"
        depends on BR2_TOOLCHAIN_HAS_THREADS
        depends on BR2_PACKAGE_SOAPYSDR
        help
          Program to decode traffic from Devices that are broadcasting on 433.9 MHz like temperature sensors 

          https://github.com/merbanan/rtl_433
comment "rtl_433 needs a toolchain w/ threads"
        depends on !BR2_TOOLCHAIN_HAS_THREADS
```

## firmware/ori/package/rtlsdr-airband/Config.in
```kconfig
config BR2_PACKAGE_RTLSDR_AIRBAND
        bool "rtlsdr-airband"
        depends on BR2_TOOLCHAIN_HAS_THREADS
        depends on BR2_PACKAGE_SOAPYSDR
        help
          RTLSDR-Airband receives analog radio voice channels and produces audio streams which can be routed to various outputs, such as online streaming services like LiveATC.net.  

          https://github.com/szpajder/RTLSDR-Airband
comment "RTLSDR_Airband needs a toolchain w/ threads"
        depends on !BR2_TOOLCHAIN_HAS_THREADS
```

## firmware/ori/package/satdump/Config.in
```kconfig
config BR2_PACKAGE_SATDUMP
	bool "satdump-master"
	depends on BR2_PACKAGE_VOLK
	depends on BR2_PACKAGE_LIBPNG
	depends on BR2_PACKAGE_TIFF
	depends on BR2_PACKAGE_JEMALLOC
	help
	  generic satellite data processing software
	  github (release)

	  https://github.com/SatDump/SatDump

	  
```

## firmware/ori/package/sigutils/Config.in
```kconfig
config BR2_PACKAGE_SIGUTILS
        bool "sigutils"
        depends on BR2_TOOLCHAIN_HAS_THREADS
#        depends on BR2_PACKAGE_SNDFILE
        help
          The sigutils library is a digital signal processing library written in C, designed for blind signal analysis and automatic demodulation in GNU/Linux.

          https://github.com/BatchDrake/sigutils
comment "sigutils needs a toolchain w/ threads"
        depends on !BR2_TOOLCHAIN_HAS_THREADS
```

## firmware/ori/package/soapyplutosdr-master/Config.in
```kconfig
config BR2_PACKAGE_SOAPYPLUTOSDR_MASTER
	bool "soapyplutosdr-master"
	depends on BR2_TOOLCHAIN_HAS_THREADS
	select BR2_PACKAGE_LIBIIO
	select BR2_PACKAGE_LIBAD9361_IIO
	help
	  Soapy SDR plugin for PlutoSDR
	  https://github.com/pothosware/SoapyPlutoSDR
```

## firmware/ori/package/soapyplutosdr/Config.in
```kconfig
config BR2_PACKAGE_SOAPYPLUTOSDR
	bool "soapyplutosdr"
	depends on BR2_TOOLCHAIN_HAS_THREADS
	select BR2_PACKAGE_LIBIIO
	select BR2_PACKAGE_LIBAD9361_IIO
	help
	  Soapy SDR plugin for PlutoSDR
	  https://github.com/pothosware/SoapyPlutoSDR
```

## firmware/ori/package/soapyremote/Config.in
```kconfig
config BR2_PACKAGE_SOAPYREMOTE
	bool "soapyremote"
#	select BR2_PACKAGE_SOAPYSDR
	help
	  Use any Soapy SDR remotely

	  https://github.com/pothosware/SoapyRemote.git
```

## firmware/ori/package/soapysdr-git/Config.in
```kconfig
config BR2_PACKAGE_SOAPYSDRGIT
	bool "soapysdr-git"
	help
	  Vendor and platform neutral SDR support library
	  github (release)

	  https://github.com/pothosware/SoapySDR.git

	  
```

## firmware/ori/package/soapysdr-master/Config.in
```kconfig
config BR2_PACKAGE_SOAPYSDR_MASTER
	bool "soapysdr-master"
	help
	  Vendor and platform neutral SDR support library
	  github (release)

	  https://github.com/pothosware/SoapySDR.git

	  
```

## firmware/ori/package/soapysdr/Config.in
```kconfig
config BR2_PACKAGE_SOAPYSDR
	bool "soapysdr"
#	select BR2_PACKAGE_PYTHON
	help
	  Vendor and platform neutral SDR support library
           
	  https://github.com/pothosware/SoapySDR.git
```
